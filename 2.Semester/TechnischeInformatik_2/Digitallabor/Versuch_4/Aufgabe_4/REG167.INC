; (c) Copyright KEIL ELEKTRONIK GmbH.  1993-1999, All rights reserved.
; Register Declarations for C167 Processor
; => \Keil3\C166\asm\*

;Erweiterungen für XE164
;A. Ditzinger

KSCCFG	DEFR	0FE1CH

P0_OUT	DEFR	0xFFA2
P0_IN	DEFR	0xFF80

P2_OUT	DEFR	0xFFA6
P2_IN	DEFR	0xFF84

P0_IOCR_0	EQU	0xE800
P0_IOCR_1	EQU	0xE800+2*1
P0_IOCR_2	EQU	0xE800+2*2
P0_IOCR_3	EQU	0xE800+2*3
P0_IOCR_4	EQU	0xE800+2*4
P0_IOCR_5	EQU	0xE800+2*5
P0_IOCR_6	EQU	0xE800+2*6
P0_IOCR_7	EQU	0xE800+2*7

P2_IOCR_0	EQU	0xE840
P2_IOCR_1	EQU	0xE840+2*1
P2_IOCR_2	EQU	0xE840+2*2
P2_IOCR_3	EQU	0xE840+2*3
P2_IOCR_4	EQU	0xE840+2*4
P2_IOCR_5	EQU	0xE840+2*5
P2_IOCR_6	EQU	0xE840+2*6
P2_IOCR_7	EQU	0xE840+2*7
P2_IOCR_8	EQU	0xE840+2*8
P2_IOCR_9	EQU	0xE840+2*9
P2_IOCR_10	EQU	0xE840+2*10
P2_IOCR_11	EQU	0xE840+2*11
P2_IOCR_12	EQU	0xE840+2*12


;* A/D Converter *
ADCIC    DEFR	0FF98H
ADCON    DEFR	0FFA0H
ADDAT    DEFR	0FEA0H
ADEIC    DEFR	0FF9AH
ADDAT2   DEFR	0F0A0H
ADST     BIT	ADCON.7
ADBSY    BIT	ADCON.8
ADWR     BIT	ADCON.9
ADCIN    BIT	ADCON.10
ADCRQ    BIT	ADCON.11
ADCIE    BIT	ADCIC.6
ADCIR    BIT	ADCIC.7
ADEIE    BIT	ADEIC.6
ADEIR    BIT	ADEIC.7

;* Timer 0, Timer 1, Timer 7, Timer 8 *
CC0      DEFR	0FE80H
CC0IC    DEFR	0FF78H
CC1      DEFR	0FE82H
CC1IC    DEFR	0FF7AH
CC2      DEFR	0FE84H
CC2IC    DEFR	0FF7CH
CC3      DEFR	0FE86H
CC3IC    DEFR	0FF7EH
CC4      DEFR	0FE88H
CC4IC    DEFR	0FF80H
CC5      DEFR	0FE8AH
CC5IC    DEFR	0FF82H
CC6      DEFR	0FE8CH
CC6IC    DEFR	0FF84H
CC7      DEFR	0FE8EH
CC7IC    DEFR	0FF86H
CC8      DEFR	0FE90H
CC8IC    DEFR	0FF88H
CC9      DEFR	0FE92H
CC9IC    DEFR	0FF8AH
CC10     DEFR	0FE94H
CC10IC   DEFR	0FF8CH
CC11     DEFR	0FE96H
CC11IC   DEFR	0FF8EH
CC12     DEFR	0FE98H
CC12IC   DEFR	0FF90H
CC13     DEFR	0FE9AH
CC13IC   DEFR	0FF92H
CC14     DEFR	0FE9CH
CC14IC   DEFR	0FF94H
CC15     DEFR	0FE9EH
CC15IC   DEFR	0FF96H
CC16     DEFR	0FE60H
CC16IC   DEFR	0F160H
CC17     DEFR	0FE62H
CC17IC   DEFR	0F162H
CC18     DEFR	0FE64H
CC18IC   DEFR	0F164H
CC19     DEFR	0FE66H
CC19IC   DEFR	0F166H
CC20     DEFR	0FE68H
CC20IC   DEFR	0F168H
CC21     DEFR	0FE6AH
CC21IC   DEFR	0F16AH
CC22     DEFR	0FE6CH
CC22IC   DEFR	0F16CH
CC23     DEFR	0FE6EH
CC23IC   DEFR	0F16EH
CC24     DEFR	0FE70H
CC24IC   DEFR	0F170H
CC25     DEFR	0FE72H
CC25IC   DEFR	0F172H
CC26     DEFR	0FE74H
CC26IC   DEFR	0F174H
CC27     DEFR	0FE76H
CC27IC   DEFR	0F176H
CC28     DEFR	0FE78H
CC28IC   DEFR	0F178H
CC29     DEFR	0FE7AH
CC29IC   DEFR	0F184H
CC30     DEFR	0FE7CH
CC30IC   DEFR	0F18CH
CC31     DEFR	0FE7EH
CC31IC   DEFR	0F194H
CCM0     DEFR	0FF52H
CCM1     DEFR	0FF54H
CCM2     DEFR	0FF56H
CCM3     DEFR	0FF58H
CCM4     DEFR	0FF22H
CCM5     DEFR	0FF24H
CCM6     DEFR	0FF26H
CCM7     DEFR	0FF28H
T0       DEFR	0FE50H
T01CON   DEFR	0FF50H
T0IC     DEFR	0FF9CH
T0REL    DEFR	0FE54H
T1       DEFR	0FE52H
T1IC     DEFR	0FF9EH
T1REL    DEFR	0FE56H
T7       DEFR	0F050H
T78CON   DEFR	0FF20H
T7IC     DEFR	0F17AH
T7REL    DEFR	0F054H
T8       DEFR	0F052H
T8IC     DEFR	0F17CH
T8REL    DEFR	0F056H
CC0IR    BIT	CC0IC.7
CC0IE    BIT	CC0IC.6
CC1IR    BIT	CC1IC.7
CC1IE    BIT	CC1IC.6
CC2IR    BIT	CC2IC.7
CC2IE    BIT	CC2IC.6
CC3IR    BIT	CC3IC.7
CC3IE    BIT	CC3IC.6
CC4IR    BIT	CC4IC.7
CC4IE    BIT	CC4IC.6
CC5IR    BIT	CC5IC.7
CC5IE    BIT	CC5IC.6
CC6IR    BIT	CC6IC.7
CC6IE    BIT	CC6IC.6
CC7IR    BIT	CC7IC.7
CC7IE    BIT	CC7IC.6
CC8IR    BIT	CC8IC.7
CC8IE    BIT	CC8IC.6
CC9IR    BIT	CC9IC.7
CC9IE    BIT	CC9IC.6
CC10IR   BIT	CC10IC.7
CC10IE   BIT	CC10IC.6
CC11IR   BIT	CC11IC.7
CC11IE   BIT	CC11IC.6
CC12IR   BIT	CC12IC.7
CC12IE   BIT	CC12IC.6
CC13IR   BIT	CC13IC.7
CC13IE   BIT	CC13IC.6
CC14IR   BIT	CC14IC.7
CC14IE   BIT	CC14IC.6
CC15IR   BIT	CC15IC.7
CC15IE   BIT	CC15IC.6
CC16IR   BIT	CC16IC.7
CC16IE   BIT	CC16IC.6
CC17IR   BIT	CC17IC.7
CC17IE   BIT	CC17IC.6
CC18IR   BIT	CC18IC.7
CC18IE   BIT	CC18IC.6
CC19IR   BIT	CC19IC.7
CC19IE   BIT	CC19IC.6
CC20IR   BIT	CC20IC.7
CC20IE   BIT	CC20IC.6
CC21IR   BIT	CC21IC.7
CC21IE   BIT	CC21IC.6
CC22IR   BIT	CC22IC.7
CC22IE   BIT	CC22IC.6
CC23IR   BIT	CC23IC.7
CC23IE   BIT	CC23IC.6
CC24IR   BIT	CC24IC.7
CC24IE   BIT	CC24IC.6
CC25IR   BIT	CC25IC.7
CC25IE   BIT	CC25IC.6
CC26IR   BIT	CC26IC.7
CC26IE   BIT	CC26IC.6
CC27IR   BIT	CC27IC.7
CC27IE   BIT	CC27IC.6
CC28IR   BIT	CC28IC.7
CC28IE   BIT	CC28IC.6
CC29IR   BIT	CC29IC.7
CC29IE   BIT	CC29IC.6
CC30IR   BIT	CC30IC.7
CC30IE   BIT	CC30IC.6
CC31IR   BIT	CC31IC.7
CC31IE   BIT	CC31IC.6
ACC0     BIT	CCM0.3
ACC1     BIT	CCM0.7
ACC2     BIT	CCM0.11
ACC3     BIT	CCM0.15
ACC4     BIT	CCM1.3
ACC5     BIT	CCM1.7
ACC6     BIT	CCM1.11
ACC7     BIT	CCM1.15
ACC8     BIT	CCM2.3
ACC9     BIT	CCM2.7
ACC10    BIT	CCM2.11
ACC11    BIT	CCM2.15
ACC12    BIT	CCM3.3
ACC13    BIT	CCM3.7
ACC14    BIT	CCM3.11
ACC15    BIT	CCM3.15
ACC16    BIT	CCM4.3
ACC17    BIT	CCM4.7
ACC18    BIT	CCM4.11
ACC19    BIT	CCM4.15
ACC20    BIT	CCM5.3
ACC21    BIT	CCM5.7
ACC22    BIT	CCM5.11
ACC23    BIT	CCM5.15
ACC24    BIT	CCM6.3
ACC25    BIT	CCM6.7
ACC26    BIT	CCM6.11
ACC27    BIT	CCM6.15
ACC28    BIT	CCM7.3
ACC29    BIT	CCM7.7
ACC30    BIT	CCM7.11
ACC31    BIT	CCM7.15
T0IE     BIT	T0IC.6
T0IR     BIT	T0IC.7
T0M      BIT	T01CON.3
T0R      BIT	T01CON.6
T1IE     BIT	T1IC.6
T1IR     BIT	T1IC.7
T1M      BIT	T01CON.11
T1R      BIT	T01CON.14
T7IE     BIT	T7IC.6
T7IR     BIT	T7IC.7
T7M      BIT	T78CON.3
T7R      BIT	T78CON.6
T8IE     BIT	T8IC.6
T8IR     BIT	T8IC.7
T8M      BIT	T78CON.11
T8R      BIT	T78CON.14

;* CPU *
CSP      DEFR	0FE08H
MDC      DEFR	0FF0EH
ONES     DEFR	0FF1EH
PSW      DEFR	0FF10H
SP       DEFR	0FE12H
STKOV    DEFR	0FE14H
STKUN    DEFR	0FE16H
SYSCON   DEFR	0FF12H
TFR      DEFR	0FFACH
ZEROS    DEFR	0FF1CH

BUSCON0  DEFR	0FF0CH
SPSEG	 DEFR	0FF0CH
BUSCON1  DEFR	0FF14H
BUSCON2  DEFR	0FF16H
BUSCON3  DEFR	0FF18H
BUSCON4  DEFR	0FF1AH
ADDRSEL1 DEFR	0FE18H
ADDRSEL2 DEFR	0FE1AH
ADDRSEL3 DEFR	0FE1CH
ADDRSEL4 DEFR	0FE1EH
WRCFG    BIT	SYSCON.7
CLKEN    BIT	SYSCON.8
BYTDIS   BIT	SYSCON.9
ROMEN    BIT	SYSCON.10
SGTEN    BIT	SYSCON.11
ROMS1    BIT	SYSCON.12
MDRIU    BIT	MDC.4
N        BIT	PSW.0
C        BIT	PSW.1
V        BIT	PSW.2
Z        BIT	PSW.3
E        BIT	PSW.4
MULIP    BIT	PSW.5
USR0     BIT	PSW.6
HLDEN    BIT	PSW.10
IEN      BIT	PSW.11
RWDC0    BIT	BUSCON0.4
MTTC0    BIT	BUSCON0.5
ALECTL0  BIT	BUSCON0.9
BUSACT0  BIT	BUSCON0.10
RDYEN0   BIT	BUSCON0.12
RWDC1    BIT	BUSCON1.4
MTTC1    BIT	BUSCON1.5
ALECTL1  BIT	BUSCON1.9
BUSACT1  BIT	BUSCON1.10
RDYEN1   BIT	BUSCON1.12
CSREN1   BIT	BUSCON1.14
CSWEN1   BIT	BUSCON1.15
RWDC2    BIT	BUSCON2.4
MTTC2    BIT	BUSCON2.5
ALECTL2  BIT	BUSCON2.9
BUSACT2  BIT	BUSCON2.10
RDYEN2   BIT	BUSCON2.12
CSREN2   BIT	BUSCON2.14
CSWEN2   BIT	BUSCON2.15
RWDC3    BIT	BUSCON3.4
MTTC3    BIT	BUSCON3.5
ALECTL3  BIT	BUSCON3.9
BUSACT3  BIT	BUSCON3.10
RDYEN3   BIT	BUSCON3.12
CSREN3   BIT	BUSCON3.14
CSWEN3   BIT	BUSCON3.15
RWDC4    BIT	BUSCON4.4
MTTC4    BIT	BUSCON4.5
ALECTL4  BIT	BUSCON4.9
BUSACT4  BIT	BUSCON4.10
RDYEN4   BIT	BUSCON4.12
CSREN4   BIT	BUSCON4.14
CSWEN4   BIT	BUSCON4.15
ILLBUS   BIT	TFR.0
ILLINA   BIT	TFR.1
ILLOPA   BIT	TFR.2
PRTFLT   BIT	TFR.3
UNDOPC   BIT	TFR.7
STKUF    BIT	TFR.13
STKOF    BIT	TFR.14
NMI      BIT	TFR.15

EXICON   DEFR	0F1C0H

ISNC     DEFR	0F1DEH
RTCIR    BIT	ISNC.0
RTCIE    BIT	ISNC.1
PLLIR    BIT	ISNC.2
PLLIE    BIT	ISNC.3


;* PEC *
PECC0    DEFR	0FEC0H
PECC1    DEFR	0FEC2H
PECC2    DEFR	0FEC4H
PECC3    DEFR	0FEC6H
PECC4    DEFR	0FEC8H
PECC5    DEFR	0FECAH
PECC6    DEFR	0FECCH
PECC7    DEFR	0FECEH

;* I/O Ports *
DP0L     DEFR	0F100H
DP0H     DEFR	0F102H
DP1L     DEFR	0F104H
DP1H     DEFR	0F106H
DP2      DEFR	0FFC2H
DP3      DEFR	0FFC6H
DP4      DEFR	0FFCAH
DP6      DEFR	0FFCEH
DP7      DEFR	0FFD2H
DP8      DEFR	0FFD6H
P0L      DEFR	0FF00H
P0H      DEFR	0FF02H
P1L      DEFR	0FF04H
P1H      DEFR	0FF06H
P2       DEFR	0FFC0H
P3       DEFR	0FFC4H
P4       DEFR	0FFC8H
P5       DEFR	0FFA2H
P6       DEFR	0FFCCH
P7       DEFR	0FFD0H
P8       DEFR	0FFD4H
ODP2     DEFR	0F1C2H
ODP3     DEFR	0F1C6H
ODP6     DEFR	0F1CEH
ODP7     DEFR	0F1D2H
ODP8     DEFR	0F1D6H
RP0H     DEFR	0F108H

;* Serial Interface *
S0BG     DEFR	0FEB4H
S0CON    DEFR	0FFB0H
S0EIC    DEFR	0FF70H
S0RBUF   DEFR	0FEB2H
S0RIC    DEFR	0FF6EH
S0TBUF   DEFR	0FEB0H
S0TBIC   DEFR	0F19CH
S0TIC    DEFR	0FF6CH
S0STP    BIT	S0CON.3
S0REN    BIT	S0CON.4
S0PEN    BIT	S0CON.5
S0FEN    BIT	S0CON.6
S0OEN    BIT	S0CON.7
S0PE     BIT	S0CON.8
S0FE     BIT	S0CON.9
S0OE     BIT	S0CON.10
S0ODD    BIT	S0CON.12
S0BRS    BIT	S0CON.13
S0LB     BIT	S0CON.14
S0R      BIT	S0CON.15
S0TIE    BIT	S0TIC.6
S0TIR    BIT	S0TIC.7
S0TBIE   BIT	S0TBIC.6
S0TBIR   BIT	S0TBIC.7
S0RIE    BIT	S0RIC.6
S0RIR    BIT	S0RIC.7
S0EIE    BIT	S0EIC.6
S0EIR    BIT	S0EIC.7

SSCTIC   DEFR	0FF72H
SSCRIC   DEFR	0FF74H
SSCEIC   DEFR	0FF76H
SSCTB    DEFR	0F0B0H
SSCRB    DEFR	0F0B2H
SSCBR    DEFR	0F0B4H
SSCCON   DEFR	0FFB2H
SSCHB    BIT	SSCCON.4
SSCPH    BIT	SSCCON.5
SSCP0    BIT	SSCCON.6
SSCTE    BIT	SSCCON.8
SSCTEN   BIT	SSCCON.8
SSCRE    BIT	SSCCON.9
SSCREN   BIT	SSCCON.9
SSCPE    BIT	SSCCON.10
SSCPEN   BIT	SSCCON.10
SSCBE    BIT	SSCCON.11
SSCBEN   BIT	SSCCON.11
SSCBSY   BIT	SSCCON.12
SSCMS    BIT	SSCCON.14
SSCEN    BIT	SSCCON.15
SSCTIR   BIT	SSCTIC.7
SSCTIE   BIT	SSCTIC.6
SSCRIR   BIT	SSCRIC.7
SSCRIE   BIT	SSCRIC.6
SSCEIR   BIT	SSCEIC.7
SSCEIE   BIT	SSCEIC.6

;* GPT1, GPT2 *
CAPREL   DEFR	0FE4AH
CRIC     DEFR	0FF6AH
T2       DEFR	0FE40H
T2CON    DEFR	0FF40H
T2IC     DEFR	0FF60H
T3       DEFR	0FE42H
T3CON    DEFR	0FF42H
T3IC     DEFR	0FF62H
T4       DEFR	0FE44H
T4CON    DEFR	0FF44H
T4IC     DEFR	0FF64H
T5       DEFR	0FE46H
T5CON    DEFR	0FF46H
T5IC     DEFR	0FF66H
T6       DEFR	0FE48H
T6CON    DEFR	0FF48H
T6IC     DEFR	0FF68H
WDT      DEFR	0FEAEH
WDTCON   DEFR	0FFAEH
CRIE     BIT	CRIC.6
CRIR     BIT	CRIC.7
T2R      BIT	T2CON.6
T2UD     BIT	T2CON.7
T2UDE    BIT	T2CON.8
T2IE     BIT	T2IC.6
T2IR     BIT	T2IC.7
T3R      BIT	T3CON.6
T3UD     BIT	T3CON.7
T3UDE    BIT	T3CON.8
T3OE     BIT	T3CON.9
T3OTL    BIT	T3CON.10
T3IE     BIT	T3IC.6
T3IR     BIT	T3IC.7
T4R      BIT	T4CON.6
T4UD     BIT	T4CON.7
T4UDE    BIT	T4CON.8
T4IE     BIT	T4IC.6
T4IR     BIT	T4IC.7
T5R      BIT	T5CON.6
T5UD     BIT	T5CON.7
T5UDE    BIT	T5CON.8
T5CLR    BIT	T5CON.14
T5SC     BIT	T5CON.15
T5IE     BIT	T5IC.6
T5IR     BIT	T5IC.7
T6R      BIT	T6CON.6
T6UD     BIT	T6CON.7
T6UDE    BIT	T6CON.8
T6OE     BIT	T6CON.9
T6OTL    BIT	T6CON.10
T6SR     BIT	T6CON.15
T6IE     BIT	T6IC.6
T6IR     BIT	T6IC.7
T0IN     BIT	P3.0
T2IN     BIT	P3.7
T3IN     BIT	P3.6
T4IN     BIT	P3.5
T5IN     BIT    P5.13;
T6IN     BIT    P5.12;
T2EUD    BIT    P5.15;
T3EUD    BIT    P3.4;
T4EUD    BIT    P5.14
T5EUD    BIT    P5.11
T3EUD    BIT	P3.4
T3OUT    BIT	P3.3
CAPIN    BIT	P3.2
T6OUT    BIT	P3.1
WDTIN    BIT	WDTCON.0
WDTR     BIT	WDTCON.1

;* PWM Module *
PWMCON0  DEFR	0FF30H
PWMCON1  DEFR	0FF32H
PW0      DEFR	0FE30H
PW1      DEFR	0FE32H
PW2      DEFR	0FE34H
PW3      DEFR	0FE36H
PWMIC    DEFR	0F17EH
PT0      DEFR	0F030H
PT1      DEFR	0F032H
PT2      DEFR	0F034H
PT3      DEFR	0F036H
PP0      DEFR	0F038H
PP1      DEFR	0F03AH
PP2      DEFR	0F03CH
PP3      DEFR	0F03EH
PTR0     BIT	PWMCON0.0
PTR1     BIT	PWMCON0.1
PTR2     BIT	PWMCON0.2
PTR3     BIT	PWMCON0.3
PTI0     BIT	PWMCON0.4
PTI1     BIT	PWMCON0.5
PTI2     BIT	PWMCON0.6
PTI3     BIT	PWMCON0.7
PIE0     BIT	PWMCON0.8
PIE1     BIT	PWMCON0.9
PIE2     BIT	PWMCON0.10
PIE3     BIT	PWMCON0.11
PIR0     BIT	PWMCON0.12
PIR1     BIT	PWMCON0.13
PIR2     BIT	PWMCON0.14
PIR3     BIT	PWMCON0.15
PEN0     BIT	PWMCON1.0
PEN1     BIT	PWMCON1.1
PEN2     BIT	PWMCON1.2
PEN3     BIT	PWMCON1.3
PM0      BIT	PWMCON1.4
PM1      BIT	PWMCON1.5
PM2      BIT	PWMCON1.6
PM3      BIT	PWMCON1.7
PB01     BIT	PWMCON1.12
PS2      BIT	PWMCON1.14
PS3      BIT	PWMCON1.15
PWMIR    BIT	PWMIC.7
PWMIE    BIT	PWMIC.6

; SYSCON2 and SYSCON3 (only in some devices)
SYSCON2  DEFR   0F1D0H
RCS      BIT    SYSCON2.6
SCS      BIT    SYSCON2.7
CLKLOCK  BIT    SYSCON2.15
SYSCON3  DEFR   0F1D4H
ADCDIS   BIT    SYSCON3.0
ASC0DIS  BIT    SYSCON3.1
SSCDIS   BIT    SYSCON3.2
GPT1DIS  BIT    SYSCON3.3
GPT2DIS  BIT    SYSCON3.4
FMDIS    BIT    SYSCON3.5
CC1DIS   BIT    SYSCON3.6
CC2DIS   BIT    SYSCON3.7
PWMDIS   BIT    SYSCON3.9
ASC1DIS  BIT    SYSCON3.10
I2CDIS   BIT    SYSCON3.11
CAN1DIS  BIT    SYSCON3.13
CAN2DIS  BIT    SYSCON3.14
PCDDIS   BIT    SYSCON3.15

;* X-Peripherals *
XP0IC    DEFR	0F186H
XP1IC    DEFR	0F18EH
XP2IC    DEFR	0F196H
XP3IC    DEFR	0F19EH
XP0IR    BIT	XP0IC.7
XP0IE    BIT	XP0IC.6
XP1IR    BIT	XP1IC.7
XP1IE    BIT	XP1IC.6
XP2IR    BIT	XP2IC.7
XP2IE    BIT	XP2IC.6
XP3IR    BIT	XP3IC.7
XP3IE    BIT	XP3IC.6

